## drivers/misc/xiaomi/Kconfig
```kconfig
# SPDX-License-Identifier: GPL-2.0-only
#
# Misc memory devices
#

menu "Xiaomi Misc devices"
source "$(KCONFIG_EXT_PREFIX)drivers/misc/xiaomi/hwid/Kconfig"
source "$(KCONFIG_EXT_PREFIX)drivers/misc/xiaomi/miev/Kconfig"
source "$(KCONFIG_EXT_PREFIX)drivers/misc/xiaomi/build_product_name/Kconfig"
source "$(KCONFIG_EXT_PREFIX)drivers/misc/xiaomi/mi_t1_chip/Kconfig"
source "$(KCONFIG_EXT_PREFIX)drivers/misc/xiaomi/mi_locking/Kconfig"
source "$(KCONFIG_EXT_PREFIX)drivers/misc/xiaomi/cam_intentaware_fsys/Kconfig"
source "$(KCONFIG_EXT_PREFIX)drivers/misc/xiaomi/debug_ext/Kconfig"
source "$(KCONFIG_EXT_PREFIX)drivers/misc/xiaomi/perf_helper/Kconfig"
source "$(KCONFIG_EXT_PREFIX)drivers/misc/xiaomi/mi_stack/Kconfig"
source "$(KCONFIG_EXT_PREFIX)drivers/misc/xiaomi/mi_ubt/Kconfig"
source "$(KCONFIG_EXT_PREFIX)drivers/misc/xiaomi/mi_ubt_test/Kconfig"
source "$(KCONFIG_EXT_PREFIX)drivers/misc/xiaomi/crash_module/Kconfig"
source "$(KCONFIG_EXT_PREFIX)drivers/misc/xiaomi/mi_memory/Kconfig"
source "$(KCONFIG_EXT_PREFIX)drivers/misc/xiaomi/perf_actuator/Kconfig"
source "$(KCONFIG_EXT_PREFIX)drivers/misc/xiaomi/miicmpfilter/Kconfig"
source "$(KCONFIG_EXT_PREFIX)drivers/misc/xiaomi/millet/Kconfig"
source "$(KCONFIG_EXT_PREFIX)drivers/misc/xiaomi/millet_oem_cgroup/Kconfig"
source "$(KCONFIG_EXT_PREFIX)drivers/misc/xiaomi/xm_power/Kconfig"
source "$(KCONFIG_EXT_PREFIX)drivers/misc/xiaomi/mi_mem_epoll/Kconfig"
source "$(KCONFIG_EXT_PREFIX)drivers/misc/xiaomi/sla/Kconfig"
source "$(KCONFIG_EXT_PREFIX)drivers/misc/xiaomi/minet/Kconfig"
source "$(KCONFIG_EXT_PREFIX)drivers/misc/xiaomi/mi_mempool/Kconfig"
source "$(KCONFIG_EXT_PREFIX)drivers/misc/xiaomi/io_monitor/Kconfig"
source "$(KCONFIG_EXT_PREFIX)drivers/misc/xiaomi/lb/Kconfig"
source "$(KCONFIG_EXT_PREFIX)drivers/misc/xiaomi/mi_schedule/Kconfig"
source "$(KCONFIG_EXT_PREFIX)drivers/misc/xiaomi/metis/Kconfig"
source "$(KCONFIG_EXT_PREFIX)drivers/misc/xiaomi/xr_qi/Kconfig"
source "$(KCONFIG_EXT_PREFIX)drivers/misc/xiaomi/xr_qs/Kconfig"
source "$(KCONFIG_EXT_PREFIX)drivers/misc/xiaomi/miwill/Kconfig"
endmenu
```

## drivers/misc/xiaomi/io_monitor/Kconfig
```kconfig
config XIAOMI_IO_MONITOR
	tristate "Xiaomi stock IO monitor reconstruction"
	depends on ARM64
	depends on BLOCK && F2FS_FS && SCSI_UFSHCD && ANDROID_VENDOR_HOOKS
	depends on TASK_IO_ACCOUNTING && TASK_XACCT && PROC_FS
	help
	  Source reconstruction of the dash OS3.0.305 io_monitor module.
	  Preserves observed stock defects; build and runtime are untested.
```

## drivers/misc/xiaomi/lb/Kconfig
```kconfig
# SPDX-License-Identifier: GPL-2.0-only
config XIAOMI_LB
	tristate "Xiaomi launch boost page recorder"
	depends on ARM64 && ARM64_4K_PAGES && MMU && SWAP && PROC_FS && ANDROID_VENDOR_HOOKS
	help
	  Stock dash launch boost interface, file-page collection and process
	  PTE snapshot/preread. Reconstructed from OS3.0.305 lb.ko; see
	  RECONSTRUCTION.txt for retained defects and untested status.
```

## drivers/misc/xiaomi/metis/Kconfig
```kconfig
# SPDX-License-Identifier: GPL-2.0-only
config XIAOMI_METIS
	tristate "Xiaomi METIS stock reconstruction"
	depends on ARM64 && ANDROID_VENDOR_HOOKS && ANDROID_VENDOR_OEM_DATA
	depends on XIAOMI_MI_SCHEDULE && XIAOMI_XR_QI
	default n
	help
	  Experimental reconstruction from dash OS3.0.305 METIS. Original
	  defects are retained. Shared native C interfaces connect the MTK
	  preemption, RT-lowest and placement providers. Rebuild scheduler
	  and METIS together; original stock C/MODVERSIONS compatibility
	  remains unresolved. See RECONSTRUCTION.md. The default is disabled;
	  this option does not select a target configuration or package the module.
	  Native compilation, KMI/CFI, loading and runtime remain untested.
```

## drivers/misc/xiaomi/mi_mem_epoll/Kconfig
```kconfig
# SPDX-License-Identifier: GPL-2.0-only

config XIAOMI_MI_MEM_EPOLL
	tristate "Xiaomi global memory reclaim and epoll interface"
	depends on ARM64 && MEMCG && PROC_FS && SYSFS
	depends on ANDROID_VENDOR_HOOKS && ANDROID_VENDOR_OEM_DATA
	help
	  Reconstruct the Redmi Turbo 5 Max stock global reclaim controls and
	  Android reclaim hooks, including the stock lowmemorykiller proc ABI.
```

## drivers/misc/xiaomi/mi_mempool/Kconfig
```kconfig
config XIAOMI_MI_MEMPOOL
	tristate "Xiaomi reserved page pool"
	depends on ARM64 && ARM64_MTE && ANDROID_VENDOR_HOOKS
	depends on ANDROID_VENDOR_OEM_DATA && SYSFS && SMP && SWAP && !NUMA
	help
	  Reconstruct the dash OS3.0.305 reserved page allocator and its sysfs
	  policy. Stock error paths and known lifetime defects are retained.
```

## drivers/misc/xiaomi/mi_schedule/Kconfig
```kconfig
# SPDX-License-Identifier: GPL-2.0
config XIAOMI_MI_SCHEDULE
	tristate "Xiaomi package runtime accounting"
	depends on ARM64 && ANDROID_VENDOR_HOOKS && ANDROID_VENDOR_OEM_DATA
	help
	  Reconstruct the dash stock mi_schedule task/UID runtime provider and
	  /proc/package interfaces. Stock failure and lifetime defects are
	  retained; see RECONSTRUCTION.txt. Build and runtime remain untested.
```

## drivers/misc/xiaomi/migt/Kconfig
```kconfig
# SPDX-License-Identifier: GPL-2.0
config XIAOMI_MIGT
	tristate "Xiaomi MiGameTurbo stock reconstruction"
	depends on ARM64 && ANDROID_VENDOR_HOOKS && ANDROID_VENDOR_OEM_DATA
	default n
	help
	  Source reconstruction of the dash stock MIGT scheduling and frequency
	  module. Stock defects are retained; see RECONSTRUCTION.txt. Real metis
	  and scheduler/FPSGO/sugov providers must be restored before integration.
	  Compilation, native ABI and runtime remain untested.
```

## drivers/misc/xiaomi/miicmpfilter/Kconfig
```kconfig
# SPDX-License-Identifier: GPL-2.0-only

config XIAOMI_MIICMPFILTER
	tristate "Xiaomi ICMP unreachable notifier"
	depends on INET && NETFILTER
	help
	  Notify privileged generic-netlink listeners about IPv4 ICMP
	  destination-unreachable packets leaving wlan0 or wlan1.
```

## drivers/misc/xiaomi/millet/Kconfig
```kconfig
# SPDX-License-Identifier: GPL-2.0-only

config XIAOMI_MILLET_CORE
	tristate "Xiaomi Millet core"
	depends on NET
	help
	  Xiaomi protocol-30 Millet transport and subsystem registry.

config XIAOMI_MILLET_HS
	tristate "Xiaomi Millet handshake"
	depends on XIAOMI_MILLET_CORE
	help
	  Kernel handshake echo subsystem.

config XIAOMI_MILLET_SIG
	tristate "Xiaomi Millet signal reporting"
	depends on XIAOMI_MILLET_CORE
	depends on FREEZER
	help
	  Reports selected signals delivered to freezing or frozen tasks.

config XIAOMI_MILLET_PKG
	tristate "Xiaomi Millet package network reporting"
	depends on XIAOMI_MILLET_CORE
	depends on NETFILTER && INET && IPV6
	help
	  Reports one incoming TCP event for each armed application UID.

config XIAOMI_BINDER_GKI
	tristate "Xiaomi Millet Binder hook bridge"
	depends on XIAOMI_MILLET_CORE
	depends on ANDROID_BINDER_IPC
	help
	  Bridges Android Binder vendor hooks to Millet callbacks.

config XIAOMI_MILLET_BINDER
	tristate "Xiaomi Millet Binder reporting"
	depends on XIAOMI_BINDER_GKI
	help
	  Reports frozen-task Binder events and application Binder status.
```

## drivers/misc/xiaomi/millet_oem_cgroup/Kconfig
```kconfig
# SPDX-License-Identifier: GPL-2.0-only

config XIAOMI_MILLET_OEM_CGROUP
	tristate "Xiaomi Millet freezer cgroup policy"
	depends on CGROUP_FREEZER
	help
	  Install Xiaomi's legacy freezer cgroup migration policy. Cross-task
	  moves are allowed only for Android system UID 1000 or callers with
	  CAP_SYS_ADMIN in the initial user namespace. Self-migration remains
	  allowed.
```

## drivers/misc/xiaomi/minet/Kconfig
```kconfig
config MINET
	tristate "Xiaomi minet flow monitor and idle notifications"
	depends on NETFILTER && NF_CONNTRACK && INET && IPV6
	depends on PM_SLEEP && ANDROID_VENDOR_OEM_DATA
	help
	  Reconstructs the OS3.0.305 minet Generic Netlink, flow accounting and
	  wlan0 idle notification contracts. Stock defects are deliberately
	  retained; see STOCK_CONTRACT.md before changing behavior.
```

## drivers/misc/xiaomi/miwill/Kconfig
```kconfig
# SPDX-License-Identifier: GPL-2.0-only
config XIAOMI_MIWiLL
	tristate "Xiaomi MiWiLL virtual network device"
	depends on NET && INET && IPV6 && NETFILTER
	default n
	help
	  Stock virtual network device and its embedded application flow monitor.
	  Source recovery only; compilation, CFI and runtime remain untested.

config XIAOMI_MIWiLL_REDUDANCY
	tristate "Xiaomi MiWiLL redudancy mode"
	depends on NET && INET
	default n
	help
	  Independent stock mode module with its own private framework registry.
```

## drivers/misc/xiaomi/perf_actuator/Kconfig
```kconfig
# SPDX-License-Identifier: GPL-2.0-only
# Copyright (C) 2026 GitHub @YorokobiMaster

config XIAOMI_PERF_ACTUATOR
	tristate "Xiaomi performance actuator"
	help
	  Provide the Xiaomi ioctl dispatch registry used by performance modules.
```

## drivers/misc/xiaomi/sla/Kconfig
```kconfig
# SPDX-License-Identifier: GPL-2.0-only

config XIAOMI_SLA
	tristate "Xiaomi SLA packet statistics collector"
	depends on ARM64 && ARM64_4K_PAGES && INET && NETFILTER && PROC_FS
	help
	  Provide the stock /proc/sla configuration, per-interface TCP
	  packet rings and counters, and UDP VoIP destination capture.
```

## drivers/misc/xiaomi/xm_power/Kconfig
```kconfig
# SPDX-License-Identifier: GPL-2.0-only

config XIAOMI_XM_POWER
	tristate "Xiaomi power detector"
	depends on ARM64 && PM_SLEEP
	depends on !VIRT_CPU_ACCOUNTING_NATIVE && !VIRT_CPU_ACCOUNTING_GEN
	help
	  Reconstruct the dash stock periodic wakeup-source and top-five thread
	  CPU-usage logger, including its /sys/xm_power controls. This preserves
	  the stock resource lifetime and parameter handling; see the reverse
	  engineering report before enabling or unloading it.
```

## drivers/misc/xiaomi/xr_qi/Kconfig
```kconfig
# SPDX-License-Identifier: GPL-2.0
config XIAOMI_XR_QI
	tristate "Xiaomi QoS inheritance provider"
	depends on ARM64 && ANDROID_VENDOR_HOOKS && ANDROID_VENDOR_OEM_DATA
	depends on XIAOMI_PERF_ACTUATOR && ANDROID_BINDER_IPC && CGROUPS && SMP && FUTEX
	depends on !PREEMPT_RT && !DEBUG_SPINLOCK && !DEBUG_LOCK_ALLOC
	depends on MUTEX_SPIN_ON_OWNER && RWSEM_SPIN_ON_OWNER
	help
	  Source reconstruction of dash stock xr-qi. See RECONSTRUCTION.txt
	  for retained stock defects, coverage gaps and untested status.
```

## drivers/misc/xiaomi/xr_qs/Kconfig
```kconfig
# SPDX-License-Identifier: GPL-2.0-only
config XIAOMI_XR_QS
	tristate "Xiaomi QoS scheduling and speedlock reconstruction"
	depends on ANDROID_VENDOR_HOOKS && XIAOMI_XR_QI && XIAOMI_MI_SCHEDULE
	help
	  Source reconstruction of dash stock xr-qs. Retains observed stock
	  behavior and defects. Build and runtime compatibility are untested.
```
